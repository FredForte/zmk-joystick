/*
 * Copyright (c) 2025 FredForte
 *
 * SPDX-License-Identifier: MIT
 *
 * Split-keyboard central receiver shield for a joystick physically wired to
 * the peripheral half (paired with zmk_joystick_peripheral).
 *
 * Receives input events via zmk,input-split (reg = <0>) and routes them into
 * &joystick_listener so layer-based input processors (such as scroll mode)
 * run on the central half.
 */

#include <zephyr/dt-bindings/input/input-event-codes.h>
#include <dt-bindings/zmk/input_transform.h>
#include <input/processors.dtsi>

/ {
    split_inputs {
        #address-cells = <1>;
        #size-cells = <0>;

        joystick_split: joystick_split@0 {
            compatible = "zmk,input-split";
            reg = <0>;
        };
    };

    joystick_listener: joystick_listener {
        compatible = "zmk,input-listener";
        device = <&joystick_split>;
    };
};
