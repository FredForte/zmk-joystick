## Kconfig
```kconfig
# Copyright (c) 2025 FredForte
# SPDX-License-Identifier: MIT

DT_COMPAT_ZMK_BATTERY_NRF_VDDH_NO_OS := zmk,battery-nrf-vddh-no-os

config ZMK_BATTERY_NRF_VDDH_NO_OS
    bool
    default $(dt_compat_enabled,$(DT_COMPAT_ZMK_BATTERY_NRF_VDDH_NO_OS))
    select ADC
    depends on SENSOR
    help
        Enable nRF VDDH battery monitoring driver with SAADC oversampling
        disabled (oversampling = 0) so battery polling can safely share the
        nRF52840 SAADC peripheral with multi-channel analog inputs.
```

## boards/shields/zmk_joystick/Kconfig.shield
```kconfig
# Copyright (c) 2025 FredForte
# SPDX-License-Identifier: MIT

config SHIELD_ZMK_JOYSTICK
    def_bool $(shields_list_contains,zmk_joystick)
```

## boards/shields/zmk_joystick_addon/Kconfig.shield
```kconfig
# Copyright (c) 2025 FredForte
# SPDX-License-Identifier: MIT

config SHIELD_ZMK_JOYSTICK_ADDON
    def_bool $(shields_list_contains,zmk_joystick_addon)
```

## boards/shields/zmk_joystick_central/Kconfig.defconfig
```kconfig
# Copyright (c) 2025 FredForte
# SPDX-License-Identifier: MIT

if SHIELD_ZMK_JOYSTICK_CENTRAL

config ZMK_POINTING
    default y

endif
```

## boards/shields/zmk_joystick_central/Kconfig.shield
```kconfig
# Copyright (c) 2025 FredForte
# SPDX-License-Identifier: MIT

config SHIELD_ZMK_JOYSTICK_CENTRAL
    def_bool $(shields_list_contains,zmk_joystick_central)
```

## boards/shields/zmk_joystick_peripheral/Kconfig.defconfig
```kconfig
# Copyright (c) 2025 FredForte
# SPDX-License-Identifier: MIT

if SHIELD_ZMK_JOYSTICK_PERIPHERAL

config ZMK_POINTING
    default y

config ADC
    default y

config ADC_ASYNC
    default y

config ANALOG_INPUT
    default y

endif
```

## boards/shields/zmk_joystick_peripheral/Kconfig.shield
```kconfig
# Copyright (c) 2025 FredForte
# SPDX-License-Identifier: MIT

config SHIELD_ZMK_JOYSTICK_PERIPHERAL
    def_bool $(shields_list_contains,zmk_joystick_peripheral)
```

## dts/bindings/sensor/zmk,battery-nrf-vddh-no-os.yaml
```yaml
# Copyright (c) 2021 The ZMK Contributors
# Copyright (c) 2025 FredForte
# SPDX-License-Identifier: MIT

description: Battery SoC monitoring using nRF VDDH without SAADC oversampling

compatible: "zmk,battery-nrf-vddh-no-os"
```
